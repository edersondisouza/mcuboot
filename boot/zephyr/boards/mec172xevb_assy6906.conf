## boot/zephyr/boards/mec172xevb_assy6906.conf
```kconfig
CONFIG_BOOT_RAM_LOAD=y
CONFIG_BOOT_IMAGE_EXECUTABLE_RAM_START=0x000C8000
CONFIG_BOOT_IMAGE_EXECUTABLE_RAM_SIZE=327680
# CONFIG_MCUBOOT_CLEANUP_ARM_CORE=n
CONFIG_BOOT_INTR_VEC_RELOC=y
CONFIG_SW_VECTOR_RELAY=y

# Minimise stuff
CONFIG_MULTITHREADING=y
CONFIG_BOOT_VALIDATE_SLOT0=n
CONFIG_BOOT_SIGNATURE_TYPE_NONE=y
CONFIG_LOG=n

# Downright crazy
CONFIG_PRINTK=n
CONFIG_CONSOLE=n
CONFIG_BOOT_BANNER=n

# ???
CONFIG_SINGLE_APPLICATION_SLOT=y
```

## samples/runtime-source/zephyr/boards/mec172xevb_assy6906.conf
```kconfig
CONFIG_I2C=y
CONFIG_FLASH_AARDVARK_I2C=y
CONFIG_SINGLE_APPLICATION_SLOT_RAM_LOAD=y

CONFIG_BOOT_IMAGE_EXECUTABLE_RAM_START=0x000C8000
CONFIG_BOOT_IMAGE_EXECUTABLE_RAM_SIZE=327680
```
