## samples/runtime-source/zephyr/boards/npcx4m8f_evb.conf
```kconfig
CONFIG_SINGLE_APPLICATION_SLOT_RAM_LOAD=y

CONFIG_BOOT_IMAGE_EXECUTABLE_RAM_START=0x10070000
CONFIG_BOOT_IMAGE_EXECUTABLE_RAM_SIZE=327680

#CONFIG_BOOT_INTR_VEC_RELOC=y
#CONFIG_SW_VECTOR_RELAY=y
#CONFIG_MCUBOOT_CLEANUP_ARM_CORE=n
#
CONFIG_LOG=n
```

## samples/zephyr/boards/npcx4m8f_evb.conf
```kconfig
CONFIG_SINGLE_APPLICATION_SLOT=y
CONFIG_SINGLE_APPLICATION_SLOT_RAM_LOAD=y
CONFIG_BOOT_IMAGE_EXECUTABLE_RAM_START=0x10070000
CONFIG_BOOT_IMAGE_EXECUTABLE_RAM_SIZE=327680

CONFIG_BOOT_SIGNATURE_TYPE_RSA=y
CONFIG_TEST_RANDOM_GENERATOR=y
CONFIG_ENTROPY_GENERATOR=y

CONFIG_LOG=n
```
